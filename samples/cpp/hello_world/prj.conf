## CMakeLists.txt
```
# SPDX-License-Identifier: Apache-2.0

cmake_minimum_required(VERSION 3.20.0)

find_package(Zephyr REQUIRED HINTS $ENV{ZEPHYR_BASE})
project(hello_cpp_world)

set(CMAKE_CXX_STANDARD             14)
set(CMAKE_CXX_STANDARD_REQUIRED    YES)
set(CMAKE_CXX_EXTENSIONS           OFF)

target_compile_options(app PRIVATE -DACTIVATION_BUF_SZ=0x00200000 -DARMCM55 -DARM_MATH_LOOPUNROLL -DARM_NPU -DETHOSU -DETHOS_U_BASE_ADDR=0x58102000 -DETHOS_U_IRQN=56 -DETHOS_U_NPU_MEMORY_MODE=ETHOS_U_NPU_MEMORY_MODE_SHARED_SRAM -DETHOS_U_NPU_TIMING_ADAPTER_ENABLED -DETHOS_U_PRIV_ENABLED=1 -DETHOS_U_SEC_ENABLED=1 -DLOG_LEVEL=LOG_LEVEL_INFO -DTF_LITE_STATIC_MEMORY -DPRJ_DES_STR="\"ARM ML Embedded Evaluation Kit\"" -DPRJ_VER_STR=\"24.02.0\")

zephyr_compile_options(-DARM_MATH_LOOPUNROLL -DCPU_CORTEX_M55 -DCPU_HEADER_FILE=\"ARMCM55.h\" -mlittle-endian -mfloat-abi=hard -flax-vector-conversions -funsigned-char -march=armv8.1-m.main+mve.fp+fp.dp)

target_sources(app PRIVATE src/main.cpp)
```

## prj.conf
```kconfig
CONFIG_CPP=y
CONFIG_REQUIRES_FULL_LIBCPP=y
CONFIG_REQUIRES_FULL_LIBC=y
CONFIG_CMSIS_DSP=y
CONFIG_CMSIS_DSP_BASICMATH=y
CONFIG_CMSIS_DSP_FASTMATH=y
CONFIG_CMSIS_DSP_STATISTICS=y
CONFIG_CMSIS_DSP_TRANSFORM=y
CONFIG_CMSIS_DSP_COMPLEXMATH=y
CONFIG_PE_LOG=y
CONFIG_PE_MATH=y
CONFIG_FP_HARDABI=y
CONFIG_FPU=y
```

## src/main.cpp
```c
/*
 * Copyright (c) 2023, Meta
 *
 * SPDX-License-Identifier: Apache-2.0
 */

#include <iostream>
#include <vector>
#include <pe_log.h>
#include <pe_math.h>

int main(void)
{
	std::cout << "SigmoidF32: " << pe_sigmoid_f32(3.3) << std::endl;
	std::vector<float> vec_flt{1.1, 1.2, 1.56, 1.75};
	pe_softmax_f32(vec_flt.data(), vec_flt.size());
	for (auto it : vec_flt) {
		std::cout << "SoftMaxF32: " << it << std::endl;
	}	
	// std::cout << "result: " << foo_sample(2) << std::endl;	
	std::cout << "Hello, C++ world! " << CONFIG_BOARD << std::endl;
	
	return 0;
}
```
