## CMakeLists.txt
```
# SPDX-License-Identifier: Apache-2.0

cmake_minimum_required(VERSION 3.20.0)

find_package(Zephyr REQUIRED HINTS $ENV{ZEPHYR_BASE})
project(hello_world)

target_compile_options(app PRIVATE -DACTIVATION_BUF_SZ=0x00200000 -DARMCM55 -DARM_MATH_LOOPUNROLL -DARM_NPU -DETHOSU -DETHOS_U_BASE_ADDR=0x58102000 -DETHOS_U_IRQN=56 -DETHOS_U_NPU_MEMORY_MODE=ETHOS_U_NPU_MEMORY_MODE_SHARED_SRAM -DETHOS_U_NPU_TIMING_ADAPTER_ENABLED -DETHOS_U_PRIV_ENABLED=1 -DETHOS_U_SEC_ENABLED=1 -DLOG_LEVEL=LOG_LEVEL_INFO -DTF_LITE_STATIC_MEMORY -DPRJ_DES_STR="\"ARM ML Embedded Evaluation Kit\"" -DPRJ_VER_STR=\"24.02.0\")

zephyr_compile_options(-DARM_MATH_LOOPUNROLL -DCPU_CORTEX_M55 -DCPU_HEADER_FILE=\"ARMCM55.h\" -mlittle-endian -mfloat-abi=hard -flax-vector-conversions -funsigned-char -march=armv8.1-m.main+mve.fp+fp.dp)

target_sources(app PRIVATE src/main.c)
```

## prj.conf
```kconfig
# nothing here
CONFIG_REQUIRES_FULL_LIBC=y
CONFIG_CMSIS_DSP=y
CONFIG_CMSIS_DSP_BASICMATH=y
CONFIG_CMSIS_DSP_FASTMATH=y
CONFIG_CMSIS_DSP_STATISTICS=y
CONFIG_CMSIS_DSP_TRANSFORM=y
CONFIG_CMSIS_DSP_COMPLEXMATH=y
CONFIG_PE_LOG=y
CONFIG_PE_MATH=y
CONFIG_FP_HARDABI=y
CONFIG_FPU=y
```

## src/main.c
```c
/*
 * Copyright (c) 2012-2014 Wind River Systems, Inc.
 *
 * SPDX-License-Identifier: Apache-2.0
 */

#include <stdio.h>
#include <pe_math.h>
#include <pe_log.h>
#include <zephyr/kernel.h>

int main(void)
{	
	PE_INFO("SigmoidF32: %f\n", pe_sigmoid_f32(3.3));
	PE_INFO("Hello World! %s\n", CONFIG_BOARD_TARGET);

	k_msleep(100);

	return 0;
}
```
