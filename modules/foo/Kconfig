## modules/foo/Kconfig
```kconfig
# Copyright (c) 2023 Meta Platforms
# SPDX-License-Identifier: Apache-2.0

config ZEPHYR_LIBFOO_MODULE
	bool

menuconfig LIBFOO
	bool "FOO Library Support"
	help
	  This option enables the LIBFOO library.
```

## modules/pe-log/Kconfig
```kconfig
# Copyright (c) 2023 Meta Platforms
# SPDX-License-Identifier: Apache-2.0

config ZEPHYR_PE_LOG_MODULE
	bool

menuconfig PE_LOG
	bool "PE_LOG Library Support"
	help
	  This option enables the PE_LOG library.

config APP_LINK_WITH_PE_LOG
	     bool "Make PE_LOG header file available to application"
	     default y
	     depends on PE_LOG
```

## modules/pe-math/Kconfig
```kconfig
# Copyright (c) 2023 Meta Platforms
# SPDX-License-Identifier: Apache-2.0

config ZEPHYR_PE_MATH_MODULE
	bool

menuconfig PE_MATH
	bool "PE_MATH Library Support"
	help
	  This option enables the PE_MATH library.
```
